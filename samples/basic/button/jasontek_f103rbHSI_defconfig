## samples/basic/button/jasontek_f103rbHSI_defconfig
```kconfig
CONFIG_ARM=y
CONFIG_BOARD_NUCLEO_F103RB=y
CONFIG_SOC_FAMILY_STM32=y
CONFIG_SOC_SERIES_STM32F1X=y
CONFIG_SOC_STM32F103XB=y
CONFIG_CORTEX_M_SYSTICK=y
# 64MHz system clock
CONFIG_SYS_CLOCK_HW_CYCLES_PER_SEC=64000000

# enable boot banner
CONFIG_BOOT_BANNER=y

# enable uart driver
CONFIG_SERIAL=y
CONFIG_UART_STM32=y
# enable USART1 - 
CONFIG_UART_STM32_PORT_1=y
CONFIG_UART_STM32_PORT_1_BAUD_RATE=115200
# enable console on this port by default
CONFIG_CONSOLE=y
CONFIG_UART_CONSOLE=y
CONFIG_UART_CONSOLE_ON_DEV_NAME="UART_1"

# enable pinmux
CONFIG_PINMUX=y
CONFIG_PINMUX_STM32=y

# enable GPIO ports A, B, C
CONFIG_GPIO=y
CONFIG_GPIO_STM32=y
CONFIG_GPIO_STM32_PORTA=y
CONFIG_GPIO_STM32_PORTB=y
CONFIG_GPIO_STM32_PORTC=y

# clock configuration
CONFIG_CLOCK_CONTROL=y
CONFIG_CLOCK_CONTROL_STM32F10X=y
CONFIG_CLOCK_STM32F10X_SYSCLK_SRC_PLL=y
# use HSI as PLL input
CONFIG_CLOCK_STM32F10X_PLL_SRC_HSI=y
# however, the board does not have an external oscillator, so just use
# the 8MHz clock signal coming from integrated STLink
# CONFIG_CLOCK_STM32F10X_HSE_BYPASS=y
# produce 64MHz clock at PLL output
CONFIG_CLOCK_STM32F10X_PLL_MULTIPLIER=16
CONFIG_CLOCK_STM32F10X_AHB_PRESCALER=0
# APB1 clock must not to exceed 36MHz limit
CONFIG_CLOCK_STM32F10X_APB1_PRESCALER=2
CONFIG_CLOCK_STM32F10X_APB2_PRESCALER=0

#enable pwm
CONFIG_PWM=y
CONFIG_PWM_STM32=y
CONFIG_PWM_STM32_1=y
```

## samples/jasontek_demos/Kconfig
```kconfig
menu "JASONTEK F103RB BOARD CONFIGURATION"

config JASONTEK_BASIC_DEMOS
prompt "build jasontek/nucleo_f103rb basic demo"
bool
default n

if JASONTEK_BASIC_DEMOS
	source "samples/jasontek_demos/src/Kconfig.demos"
endif # JASONTEK_BASIC_DEMOS

endmenu
```

## samples/jasontek_demos/src/Kconfig.demos
```kconfig
choice
prompt "DEMO Select"
default JASONTEK_BTNDEMO

config JASONTEK_BTNDEMO
	bool "USER button pressed demo"	
	select GPIO
	
config JASONTEK_PWMDEMO
	bool "PWM--fadeLED demo"	
	select PWM
	select PRINTK
	select STDOUT_CONSOLE	
	
config JASONTEK_SHELLDEMO
	bool "shell demo"
	select CONSOLE_HANDLER
	select CONSOLE_HANDLER_SHELL
	select ENABLE_SHELL
	select PRINTK
	select KERNEL_SHELL
	select MINIMAL_LIBC_EXTENDED
	
config JASONTEK_SYNCDEMO
	bool "synchronization demo"
	select STDOUT_CONSOLE
	
config JASONTEK_PHILDEMO
	bool "Dining Philosophers problem demo"
	select ASSERT
	select INIT_STACKS
	
	
endchoice
```
